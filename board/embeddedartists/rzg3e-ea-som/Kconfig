## board/embeddedartists/rzg3e-ea-som/Kconfig
```kconfig
if TARGET_RZG3E_EA_SOM

config SYS_SOC
	default "renesas"

config SYS_BOARD
	default "rzg3e-ea-som"

config SYS_VENDOR
	default "embeddedartists"

config SYS_CONFIG_NAME
	default "rzg3e-ea-som"

endif
```

## board/embeddedartists/rzg3l-ea-som/Kconfig
```kconfig
if TARGET_RZG3L_EA_SOM

config SYS_SOC
	default "renesas"

config SYS_BOARD
	default "rzg3l-ea-som"

config SYS_VENDOR
	default "embeddedartists"

config SYS_CONFIG_NAME
	default "rzg3l-ea-som"

endif
```
